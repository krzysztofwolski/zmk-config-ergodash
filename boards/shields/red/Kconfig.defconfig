## boards/shields/red/Kconfig.defconfig
```kconfig
# Copyright (c) 2020 The ZMK Contributors
# SPDX-License-Identifier: MIT

if SHIELD_RED_LEFT

config ZMK_KEYBOARD_NAME
    default "Red"

config ZMK_SPLIT_ROLE_CENTRAL
    default y

endif

if SHIELD_RED_LEFT || SHIELD_RED_RIGHT

config ZMK_SPLIT
    default y

endif
```

## boards/shields/red/Kconfig.shield
```kconfig
# Copyright (c) 2020 The ZMK Contributors
# SPDX-License-Identifier: MIT

config SHIELD_RED_LEFT
    def_bool $(shields_list_contains,red_left)

config SHIELD_RED_RIGHT
    def_bool $(shields_list_contains,red_right)
```
